## boards/shields/foxpad/Kconfig.defconfig
```kconfig
# Copyright (c) 2020 The ZMK Contributors
# SPDX-License-Identifier: MIT

if SHIELD_FOXPAD

config ZMK_KEYBOARD_NAME
    default "FoxPad"

endif
```

## boards/shields/foxpad/Kconfig.shield
```kconfig
# Copyright (c) 2020 The ZMK Contributors
# SPDX-License-Identifier: MIT

config SHIELD_FOXPAD
    def_bool $(shields_list_contains,foxpad)
```

## boards/shields/gamepad/Kconfig.defconfig
```kconfig
# Copyright (c) 2020 The ZMK Contributors
# SPDX-License-Identifier: MIT

if SHIELD_GAMEPAD

config ZMK_KEYBOARD_NAME
    default "GamePad"

endif
```

## boards/shields/gamepad/Kconfig.shield
```kconfig
# Copyright (c) 2020 The ZMK Contributors
# SPDX-License-Identifier: MIT

config SHIELD_GAMEPAD
    def_bool $(shields_list_contains,gamepad)
```
