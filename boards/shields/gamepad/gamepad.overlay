/*
 * Copyright (c) 2020 The ZMK Contributors
 *
 * SPDX-License-Identifier: MIT
 */

#include <dt-bindings/zmk/matrix_transform.h>

/ {
    chosen {
        zmk,kscan = &kscan0;
    };

    kscan0: kscan {
        compatible = "zmk,kscan-gpio-matrix";
        wakeup-source;

        diode-direction = "col2row";

        row-gpios
            = <&pro_micro  4 (GPIO_ACTIVE_LOW | GPIO_PULL_UP)>
            , <&pro_micro  3 (GPIO_ACTIVE_LOW | GPIO_PULL_UP)>
            , <&pro_micro  2 (GPIO_ACTIVE_LOW | GPIO_PULL_UP)>
            , <&pro_micro  0 (GPIO_ACTIVE_LOW | GPIO_PULL_UP)>
            , <&pro_micro  1 (GPIO_ACTIVE_LOW | GPIO_PULL_UP)>
            ;

        col-gpios
            = <&pro_micro  5 GPIO_ACTIVE_LOW>
            , <&pro_micro  6 GPIO_ACTIVE_LOW>
            , <&pro_micro  7 GPIO_ACTIVE_LOW>
            , <&pro_micro  8 GPIO_ACTIVE_LOW>
            , <&pro_micro  9 GPIO_ACTIVE_LOW>
            , <&pro_micro 16 GPIO_ACTIVE_LOW>
            , <&pro_micro 10 GPIO_ACTIVE_LOW>
            ;

        debounce-press-ms = <1>;
    };
};